/*<FH+>************************************************************************/
/*                                                                            */
/* 版权所有: 北京智芯微电子                                                   */
/*                                                                            */
/* 文件名称: SCM62X_I2C.c                                                     */
/* 内容摘要: I2C模块基础函数定义                                              */
/* 其它说明: **                                                               */
/* 当前版本: V1.0                                                             */
/* 作    者: SCM                                                              */
/* 完成日期: 2019-03-20                                                       */
/* 修改记录:                                                                  */
/*    修改日期          版本号        修改人        修改内容                  */
/* -------------------------------------------------------------------------- */
/*    2019-03-20        V1.0          SCM        创建文件                     */
/*<FH->************************************************************************/


/******************************************************************************/
/*               #include（依次为标准库头文件、非标准库头文件）               */
/******************************************************************************/
#include "SCM62X.h"

/******************************************************************************/
/*                                外部引用定义                                */
/******************************************************************************/


/******************************************************************************/
/*                                  全局变量                                  */
/******************************************************************************/


/******************************************************************************/
/*                                 函数的实现                                 */
/******************************************************************************/
/*<FUNC+>**********************************************************************/
/* 函数名称: I2C_Init                                                         */
/* 功能描述: I2C模块初始化                                                    */
/* 输入参数: i2cx --- SGCC_I2C0_P/SGCC_I2C1_P                                 */
/*           i2cInit --- 初始化配置参数                                       */
/* 输出参数: 无                                                               */
/* 返 回 值: 无                                                               */
/* 操作流程:                                                                  */
/* 其它说明: 无                                                               */
/* 修改记录:                                                                  */
/* -------------------------------------------------------------------------- */
/*    2018-11-16        V1.00         SCM           创建函数                  */
/*<FUNC->**********************************************************************/
void I2C_Init( SGCC_I2C_TypeDef* i2cx,  I2C_InitTypeDef i2cInit) 
{
    uint32_t temp;
    
    /* I2CCLK时钟源是PCLK，所以这里的SYS_FREQ是PCLK  */
    temp = SYS_FREQ/(2 * i2cInit.scl);
    i2cx->CLKR = temp;
    
    temp = i2cx->CFGR;
    temp &= ~I2C_CFGR_DBCN;
    temp |= i2cInit.prescale;
    i2cx->CFGR = temp;
    
    if(i2cInit.mode == I2C_SLAVE)
    {
        temp = i2cx->CFGR;
        temp &= ~I2C_CFGR_TO;
        temp |= i2cInit.timeoutEn;
        
        temp &= ~I2C_CFGR_STR;
        temp |= i2cInit.stretchEn;
        i2cx->CFGR = temp;
        
        i2cx->ADR = i2cInit.addrMode | i2cInit.addrMask
                  | i2cInit.gCallEn  | i2cInit.slaveAddr;
    }
}

/*<FUNC+>**********************************************************************/
/* 函数名称: I2C_Enable                                                       */
/* 功能描述: I2C模块使能,I2C开始工作                                          */
/* 输入参数: i2cx --- I2C模块编号  (SGCC_I2C0_P/SGCC_I2C1_P)                  */
/* 输出参数: 无                                                               */
/* 返 回 值: 无                                                               */
/* 操作流程:                                                                  */
/* 其它说明: 无                                                               */
/* 修改记录:                                                                  */
/* -------------------------------------------------------------------------- */
/*    2018-01-10        V1.00         SCM           创建函数                  */
/*<FUNC->**********************************************************************/
void I2C_Enable(SGCC_I2C_TypeDef* i2cx)
{
    i2cx->CFGR |= I2C_CFGR_IICE_EN;
}

/*<FUNC+>**********************************************************************/
/* 函数名称: I2C_Disable                                                      */
/* 功能描述: I2C模块禁止,I2C模块软复位,但不会复位配置类寄存器                 */
/* 输入参数: i2cx --- I2C模块编号  (SGCC_I2C0_P/SGCC_I2C1_P)                  */
/* 输出参数: 无                                                               */
/* 返 回 值: 无                                                               */
/* 操作流程:                                                                  */
/* 其它说明: 无                                                               */
/* 修改记录:                                                                  */
/* -------------------------------------------------------------------------- */
/*    2018-01-10        V1.00         SCM           创建函数                  */
/*<FUNC->**********************************************************************/
void I2C_Disable(SGCC_I2C_TypeDef* i2cx)
{
    i2cx->CFGR &= ~I2C_CFGR_IICE_EN;
}

/*<FUNC+>**********************************************************************/
/* 函数名称: I2C_EnableIntr                                                   */
/* 功能描述: 中断使能 (中断总开关,在配置完中断后调用打开中断总开关)           */
/* 输入参数: i2cx --- I2C模块的编号  SGCC_I2C0_P or SGCC_I2C1_P               */
/* 输出参数: 无                                                               */
/* 返 回 值: 无                                                               */
/* 操作流程:                                                                  */
/* 其它说明: 无                                                               */
/* 修改记录:                                                                  */
/* -------------------------------------------------------------------------- */
/*    2018-01-10        V1.00         SCM           创建函数                  */
/*<FUNC->**********************************************************************/
void I2C_EnableIntr(SGCC_I2C_TypeDef* i2cx)
{
    i2cx->CFGR |= I2C_CFGR_INT_EN;
}

/*<FUNC+>**********************************************************************/
/* 函数名称: I2C_DisableIntr                                                  */
/* 功能描述: 中断禁止(中断总开关,调用之后关闭所有中断)                        */
/* 输入参数: i2cx --- I2C模块编号  (SGCC_I2C0_P/SGCC_I2C1_P)                  */
/* 输出参数: 无                                                               */
/* 返 回 值: 无                                                               */
/* 操作流程:                                                                  */
/* 其它说明: 无                                                               */
/* 修改记录:                                                                  */
/* -------------------------------------------------------------------------- */
/*    2018-01-09        V1.00         SCM           创建函数                  */
/*<FUNC->**********************************************************************/
void I2C_DisableIntr(SGCC_I2C_TypeDef* i2cx)
{
    i2cx->CFGR &= ~I2C_CFGR_INT_EN;
}

/*<FUNC+>**********************************************************************/
/* 函数名称: I2C_ITConfig                                                     */
/* 功能描述: 中断配置,(对各个中断事件的使能和禁止操作,使能操作之后需要调用总  */
 /*                    的中断使能函数)                                        */
/* 输入参数: i2cx --- I2C模块编号  (SGCC_I2C0_P/SGCC_I2C1_P)                  */
/* 输入参数: I2C_IT --- 要改变状态的I2C中断事件,如下                          */
/*                      I2C_CFGR_DEI_EN         数据错误中断使能              */
/*                      I2C_CFGR_AKF_EN         响应失败中断使能              */
/*                      I2C_CFGR_STAD_EN        开始条件中断使能              */
/*                      I2C_CFGR_STOD_EN        结束条件中断使能              */
/*                      I2C_CFGR_BYD_EN         字节传输完成中断使能          */
/*                      I2C_CFGR_RXOV_EN        接收缓冲溢出中断使能          */
/*                      I2C_CFGR_TXOV_EN        发送缓冲溢出中断使能          */
/*                      I2C_CFGR_ARB_EN         仲裁失败中断使能,仲裁使能     */
/*                      I2C_CFGR_BSE_EN         总线错误中断使能              */
/*                      I2C_CFGR_TIO_EN         SCL为低或SDA为低超时中断使能  */
/*           NewState --- 中断的新状态,使能或禁止                             */
/* 输出参数: 无                                                               */
/* 返 回 值: 无                                                               */
/* 操作流程:                                                                  */
/* 其它说明: 无                                                               */
/* 修改记录:                                                                  */
/* -------------------------------------------------------------------------- */
/*    2018-01-10        V1.00         SCM           创建函数                  */
/*<FUNC->**********************************************************************/
void I2C_ITConfig(SGCC_I2C_TypeDef* i2cx, uint32_t I2C_IT, 
                  FunctionalState NewState)
{
    if (NewState != DISABLE)
    {
      /* 使能相应的I2C中断 */
      i2cx->CFGR |= I2C_IT;
    }
    else
    {
      /* 禁止选择的I2C中断 */
      i2cx->CFGR &= ~I2C_IT;
    }
}

/*<FUNC+>**********************************************************************/
/* 函数名称: I2C_WrCmd                                                        */
/* 功能描述: I2C寄存器命令写入                                                */
/* 输入参数: i2cx --- I2C模块编号                                             */
/*           cmd --- 命令参数                                                 */
/*                   I2C_CMDR_MODE_MASTER , I2C_CMDR_MODE_SLAVE               */
/*                   I2C_CMDR_RSTA_EN     , I2C_CMDR_RSTA_DIS                 */
/*                   I2C_CMDR_NACK        , I2C_CMDR_ACK                      */
/*                   I2C_CMDR_DMA_EN      , I2C_CMDR_DMA_DIS                  */
/* 输出参数: 无                                                               */
/* 返 回 值: 无                                                               */
/* 操作流程: 调用此函数时，使用上述参数，其中在配置过程中，每行里左侧的优先级 */
/*           大于右侧的优先级。比如，同时设置了I2C_CMDR_MODE_MASTER和         */
/*           I2C_CMDR_MODE_SLAVE，那么参数I2C_CMDR_MODE_MASTER有效，          */
/*           I2C_CMDR_MODE_SLAVE无效                                          */
/* 其它说明:                                                                  */
/* -------------------------------------------------------------------------- */
/*    2018-01-11        V1.00         SCM           创建函数                  */
/*<FUNC->**********************************************************************/
void I2C_WrCmd( SGCC_I2C_TypeDef* i2cx, uint32_t cmd ) 
{
    i2cx->CMDR = (i2cx->CMDR & (~((cmd>>4)&0x0F))) | (cmd&0x0F); 
}

/*<FUNC+>**********************************************************************/
/* 函数名称: I2C_GetFlagStatus                                                */
/* 功能描述: 获取状态标志                                                     */
/* 输入参数: i2cx --- I2C模块编号                                             */
/*           I2C_FLAG --- 想要获取I2C事件的状态信息                           */
/*                          I2C_SR_ADMB                                       */
/*                          I2C_SR_TIPB                                       */
/*                          I2C_SR_TRDB                                       */
/*                          I2C_SR_BUFB                                       */
/*                          I2C_SR_GCAMB                                      */
/*                          I2C_SR_DATAERR                                    */
/*                          I2C_SR_ACKFAIL                                    */
/*                          I2C_SR_START                                      */
/*                          I2C_SR_STOP                                       */
/*                          I2C_SR_BYTEDONE                                   */
/*                          I2C_SR_RXOV                                       */
/*                          I2C_SR_TXOV                                       */
/*                          I2C_SR_ARBLOST                                    */
/*                          I2C_SR_BUFERR                                     */
/*                          I2C_SR_TIMEOUT                                    */
/* 输出参数: 无                                                               */
/* 返 回 值: FlagStatus --- SET or RESET                                      */
/* 操作流程:                                                                  */
/* 其它说明: 无                                                               */
/* 修改记录:                                                                  */
/* -------------------------------------------------------------------------- */
/*    2018-01-11        V1.00         SCM           创建函数                  */
/*<FUNC->**********************************************************************/
FlagStatus I2C_GetFlagStatus(SGCC_I2C_TypeDef* i2cx, uint32_t I2C_FLAG)
{
    FlagStatus bitstatus = RESET;

    if(i2cx->SR & I2C_FLAG)
    {
        bitstatus = SET;
    }
    else
    {
        bitstatus = RESET;
    }
    return  bitstatus;
}

/*<FUNC+>**********************************************************************/
/* 函数名称: I2C_ClrSts                                                       */
/* 功能描述: 清除I2C标志                                                      */
/* 输入参数: i2cx --- I2C模块编号                                             */
/*           I2C_FLAG --- I2C相应事件标志                                     */ 
/*                          I2C_SR_DATAERR                                    */
/*                          I2C_SR_ACKFAIL                                    */
/*                          I2C_SR_START                                      */
/*                          I2C_SR_STOP                                       */
/*                          I2C_SR_BYTEDONE                                   */
/*                          I2C_SR_RXOV                                       */
/*                          I2C_SR_TXOV                                       */
/*                          I2C_SR_ARBLOST                                    */
/*                          I2C_SR_BUFERR                                     */
/*                          I2C_SR_TIMEOUT                                    */
/* 输出参数: 无                                                               */
/* 返 回 值: 无                                                               */
/* 操作流程:                                                                  */
/* 其它说明: 无                                                               */
/* 修改记录:                                                                  */
/* -------------------------------------------------------------------------- */
/*    2018-01-11        V1.00         SCM           创建函数                  */
/*<FUNC->**********************************************************************/
void I2C_ClrSts(SGCC_I2C_TypeDef* i2cx, uint32_t I2C_FLAG)     
{
    i2cx->SR = I2C_FLAG;  
}

/*<FUNC+>**********************************************************************/
/* 函数名称: I2C_SendData                                                     */
/* 功能描述: I2C发送一个字节数据                                              */
/* 输入参数: i2cx --- I2C模块编号                                             */
/*           data --- 要发送的数据                                            */
/* 输出参数: 无                                                               */
/* 返 回 值: 无                                                               */
/* 操作流程:                                                                  */
/* 其它说明: 无                                                               */
/* 修改记录:                                                                  */
/* -------------------------------------------------------------------------- */
/*    2018-01-11        V1.00         SCM           创建函数                  */
/*<FUNC->**********************************************************************/
void I2C_SendData(SGCC_I2C_TypeDef* i2cx, uint8_t data) 
{
   i2cx->BUFR = data;          
}

/*<FUNC+>**********************************************************************/
/* 函数名称: I2C_ReceiveData                                                  */
/* 功能描述: I2C接收一个字节的数据                                            */
/* 输入参数: i2cx --- I2C模块的编号                                           */
/* 输出参数: 无                                                               */
/* 返 回 值: uint8_t --- I2C接收到的数据                                      */
/* 操作流程:                                                                  */
/* 其它说明: 无                                                               */
/* 修改记录:                                                                  */
/* -------------------------------------------------------------------------- */
/*    2018-01-11        V1.00         SCM           创建函数                  */
/*<FUNC->**********************************************************************/
uint8_t I2C_ReceiveData(SGCC_I2C_TypeDef* i2cx) 
{
    return i2cx->BUFR;
}

/*<FUNC+>**********************************************************************/
/* 函数名称: I2C_SendByteOnly                                                 */
/* 功能描述: I2C模块发送一个字节,不必等待发送完成                             */
/* 输入参数: i2cx --- I2C模块编号                                             */
/*           data --- 要发送的数据                                            */
/*           mode --- 模式选择  I2C_CMDR_MODE_MASTER/I2C_CMDR_MODE_SLAVE      */
/* 输出参数: 无                                                               */
/* 返 回 值: 无                                                               */
/* 操作流程:                                                                  */
/* 其它说明: 无                                                               */
/* 修改记录:                                                                  */
/* -------------------------------------------------------------------------- */
/*    2018-01-11        V1.00         SCM           创建函数                  */
/*<FUNC->**********************************************************************/
void I2C_SendByteOnly(SGCC_I2C_TypeDef* i2cx, uint8_t data, uint8_t mode) 
{
    I2C_SendData(i2cx,data);
    I2C_WrCmd(i2cx, mode );
}

/*<FUNC+>**********************************************************************/
/* 函数名称: I2C_SendByteTillDone                                             */
/* 功能描述: i2c发送一个字节并等待发送完成                                    */
/* 输入参数: i2cx --- I2C模块编号                                             */
/*           data --- 要发送的数据                                            */
/*           mode --- 模式选择  I2C_CMDR_MODE_MASTER/I2C_CMDR_MODE_SLAVE      */
/* 输出参数: 无                                                               */
/* 返 回 值: ErrorStatus --- 是否成功  SUCCESS/ERROR                          */
/* 操作流程:                                                                  */
/* 其它说明: 无                                                               */
/* 修改记录:                                                                  */
/* -------------------------------------------------------------------------- */
/*    2018-01-11        V1.00         SCM           创建函数                  */
/*<FUNC->**********************************************************************/
ErrorStatus I2C_SendByteTillDone(SGCC_I2C_TypeDef* i2cx, uint8_t data) 
{
    uint32_t loop = 50000;
    
    I2C_SendData(i2cx,data);

    // 等待数据发送中断  
    while (I2C_GetFlagStatus(i2cx, I2C_SR_BYTEDONE) != SET)
    {
        loop--;
        if (loop == 0)
        {
            return ERROR;
        }
    }
    I2C_ClrSts(i2cx, I2C_SR_BYTEDONE);      /* 清空标志                       */
    return SUCCESS;
}

/*<FUNC+>**********************************************************************/
/* 函数名称: I2C_ReceiveByte                                                  */
/* 功能描述: I2C接收一个字节的数据                                            */
/* 输入参数: i2cx --- I2C模块编号                                             */
/*           data --- 指向用于存储接收的数据存储空间的指针                    */
/* 输出参数: 无                                                               */
/* 返 回 值: ErrorStatus --- 是否成功  SUCCESS/ERROR                          */
/* 操作流程:                                                                  */
/* 其它说明: 无                                                               */
/* 修改记录:                                                                  */
/* -------------------------------------------------------------------------- */
/*    2018-01-11        V1.00         SCM           创建函数                  */
/*<FUNC->**********************************************************************/
ErrorStatus I2C_ReceiveByte(SGCC_I2C_TypeDef* i2cx, uint8_t *data) 
{
    uint32_t loop = 50000;
     
    while (!((I2C_GetFlagStatus(i2cx, I2C_SR_BYTEDONE) == SET)
           &&(I2C_GetFlagStatus(i2cx, I2C_SR_BUF) == SET)))
    {
        loop--;
        if (loop == 0)
        {
            return ERROR;
        }
    }

    *data = I2C_ReceiveData(i2cx);
    I2C_ClrSts(i2cx, I2C_SR_BYTEDONE);

    //i2cx->CMDR &= ~(1 << 2);     // 数据接收之后回复ACK
    I2C_WrCmd(i2cx,I2C_CMDR_ACK);
    return SUCCESS;
}

/*<FUNC+>**********************************************************************/
/* 函数名称: I2C_ReceivelastByte                                              */
/* 功能描述: I2C接收最后一个字节数据                                          */
/* 输入参数: i2cx --- I2C模块编号                                             */
/*           data --- 指向用于存储接收的数据存储空间的指针                    */
/* 输出参数: 无                                                               */
/* 返 回 值: ErrorStatus --- 是否成功  SUCCESS/ERROR                          */
/* 操作流程:                                                                  */
/* 其它说明: 无                                                               */
/* 修改记录:                                                                  */
/* -------------------------------------------------------------------------- */
/*    2018-01-11        V1.00         SCM           创建函数                  */
/*<FUNC->**********************************************************************/
ErrorStatus I2C_ReceivelastByte(SGCC_I2C_TypeDef* i2cx, uint8_t *data ) 
{
    uint32_t loop = 50000;

   // i2cx->CMDR &= ~(1 << 2);     // 数据接收之后回复ACK
    
    // 等待数据发送中断  
    while (I2C_GetFlagStatus(i2cx, I2C_SR_BYTEDONE) != SET)
    {
        loop--;
        if (loop == 0)
        {
            return ERROR;
        }
    }

    I2C_ClrSts(i2cx, I2C_SR_BYTEDONE);
    *data = I2C_ReceiveData(i2cx); 

    I2C_WrCmd(i2cx, I2C_CMDR_NACK|I2C_CMDR_MODE_SLAVE);   // NACK + STOP,最后一个数据不返回ACK

    loop = 50000;
    while (I2C_GetFlagStatus(i2cx, I2C_SR_STOP) != SET)
    {
        loop--;
        if (loop == 0)
        {
            return ERROR;
        }
    }
    I2C_ClrSts(i2cx, I2C_SR_STOP);

    
    /* 在停止读之后，需要判断一下buff是否为满，如果还有数，需要读取buff来清空 */
    if (I2C_GetFlagStatus(i2cx, I2C_SR_BUF) == SET)
    {
        I2C_ReceiveData(i2cx); 
    }
    
    return SUCCESS;
}

/*<FUNC+>**********************************************************************/
/* 函数名称: I2C_SendByteTillDone                                             */
/* 功能描述: i2c发送一个字节并等待发送完成                                    */
/* 输入参数: i2cx --- I2C模块编号                                             */
/*           data --- 要发送的数据                                            */
/*           mode --- 模式选择  I2C_CMDR_MODE_MASTER/I2C_CMDR_MODE_SLAVE      */
/* 输出参数: 无                                                               */
/* 返 回 值: ErrorStatus --- 是否成功  SUCCESS/ERROR                          */
/* 操作流程:                                                                  */
/* 其它说明: 无                                                               */
/* 修改记录:                                                                  */
/* -------------------------------------------------------------------------- */
/*    2018-01-11        V1.00         SCM           创建函数                  */
/*<FUNC->**********************************************************************/
ErrorStatus I2C_Start(SGCC_I2C_TypeDef* i2cx) 
{
    uint32_t loop = 50000;
    

    I2C_WrCmd(i2cx, I2C_CMDR_MODE_MASTER);
    // 等待数据发送中断  
    while (I2C_GetFlagStatus(i2cx, I2C_SR_START) != SET)
    {
        loop--;
        if (loop == 0)
        {
            return ERROR;
        }
    }
    I2C_ClrSts(i2cx, I2C_SR_START);         // ???
    
    return SUCCESS;
}

/*<FUNC+>**********************************************************************/
/* 函数名称: I2C_SendlastByte                                                 */
/* 功能描述: I2C发送最后一个字节,之后发送一个停止信号                         */
/* 输入参数: i2cx --- I2C模块的编号                                           */
/*           data --- 要发送的数据                                            */
/*           mode --- 模式选择  I2C_CMDR_MODE_MASTER/I2C_CMDR_MODE_SLAVE      */
/* 输出参数: 无                                                               */
/* 返 回 值: ErrorStatus --- 是否成功  SUCCESS/ERROR                          */
/* 操作流程:                                                                  */
/* 其它说明: 无                                                               */
/* 修改记录:                                                                  */
/* -------------------------------------------------------------------------- */
/*    2018-01-11        V1.00         SCM           创建函数                  */
/*<FUNC->**********************************************************************/
ErrorStatus I2C_Stop(SGCC_I2C_TypeDef* i2cx) 
{
    uint32_t loop = 50000;
    
    I2C_WrCmd(i2cx, I2C_CMDR_ACK | I2C_CMDR_MODE_SLAVE);   /* 发送ACK,并产生stop信号         */

    I2C_ClrSts(i2cx, I2C_SR_BYTEDONE);
    
    while (I2C_GetFlagStatus(i2cx, I2C_SR_STOP) != SET)
    {
        loop--;
        if (loop == 0)
        {
            return ERROR;
        }
    }
    I2C_ClrSts(i2cx, I2C_SR_STOP);

    return SUCCESS;  
}

ErrorStatus I2C_ReStart(SGCC_I2C_TypeDef* i2cx) 
{
    uint32_t loop = 50000;
    
    // 启动重新开始信号使能
    I2C_WrCmd(i2cx, I2C_CMDR_MODE_MASTER|I2C_CMDR_RSTA_EN);
    
    // 等待重新开始信号完成
    while (I2C_GetFlagStatus(i2cx, I2C_SR_START) != SET)
    {
        loop--;
        if (loop == 0)
        {
            return ERROR;
        }
    }
    I2C_ClrSts(i2cx, I2C_SR_START);         /* 清空标志                       */
    return SUCCESS; 
}
